## ESP32-P4-Platform/examples/esp-idf/05_gpio_pwm_led/main/Kconfig.projbuild
```kconfig
menu "GPIO IO Example Configuration"

    config EXAMPLE_GPIO_OUTPUT
        int "Output GPIO number"
        default 2

    config EXAMPLE_GPIO_INPUT
        int "Input GPIO number"
        default 3

    config EXAMPLE_GPIO_INPUT_PULLUP
        bool "Enable input pull-up"
        default y

endmenu
```
